## prj.conf
```kconfig
# UART support
CONFIG_SERIAL=y
CONFIG_GPIO=y

CONFIG_ENTROPY_GENERATOR=y
CONFIG_TEST_RANDOM_GENERATOR=y
CONFIG_INIT_STACKS=y
CONFIG_HW_STACK_PROTECTION=y
CONFIG_NEWLIB_LIBC=y
CONFIG_POSIX_API=y
CONFIG_POSIX_MAX_FDS=6
CONFIG_JSON_LIBRARY=y
CONFIG_GPIO=y
CONFIG_BT=y
CONFIG_BT_OBSERVER=y
CONFIG_BT_BROADCASTER=y
CONFIG_BT_CTLR_ADV_EXT=y
CONFIG_BT_EXT_ADV=y
CONFIG_BT_CENTRAL=y
CONFIG_BT_FILTER_ACCEPT_LIST=y


# Enable Extended Scanning
CONFIG_BT_EXT_ADV=y
CONFIG_BT_EXT_SCAN_BUF_SIZE=1650
CONFIG_BT_CTLR_ADV_DATA_LEN_MAX=1650

# Zephyr Bluetooth LE Controller needs 16 event buffers to generate Extended
# Advertising Report for receiving the complete 1650 bytes of data
CONFIG_BT_BUF_EVT_RX_COUNT=20

# Set maximum scan data length for Extended Scanning in Bluetooth LE Controller
CONFIG_BT_CTLR_SCAN_DATA_LEN_MAX= 1650

# Increase Zephyr Bluetooth LE Controller Rx buffer to receive complete chain
# of PDUs
CONFIG_BT_CTLR_RX_BUFFERS=16

CONFIG_BT_CTLR_FAL_SIZE=8

#PERIODIC SCANNING CONFIGURATION 
CONFIG_BT_PER_ADV_SYNC=y
CONFIG_BT_CTLR_SYNC_PERIODIC=y
CONFIG_BT_PER_ADV_SYNC_BUF_SIZE=1650
CONFIG_BT_CTLR_SDC_PERIODIC_SYNC_BUFFER_COUNT=10

CONFIG_SERIAL=y
CONFIG_LOG=y

#############
CONFIG_NEWLIB_LIBC=y
CONFIG_BT_PER_ADV_SYNC_MAX=4
CONFIG_BT_LL_SW_SPLIT=y
CONFIG_BT_LL_SOFTDEVICE=y
CONFIG_LOG_MODE_MINIMAL=y
```

## nrf52dk_nrf52832.overlay
```dts
/ {
    leds {
		compatible = "gpio-leds";
		led0: led_0 {
			gpios = <&gpio0 18 GPIO_ACTIVE_LOW>;  /* Make changes in GPIO pin accroding to your Board */
			label = "Green LED 0";
		};
    };
};
```

## src/main.c
```c
/*
 * Copyright (c) 2022 Nordic Semiconductor ASA
 *
 * SPDX-License-Identifier: Apache-2.0
 */

#include <zephyr/sys/printk.h>
#include <zephyr/bluetooth/bluetooth.h>



int observer_start(void);


static void set_random_static_address(void)
{
int err;
        int err1;
	printk("Starting iBeacon Demo\n");
        
		bt_addr_le_t addr;

		//convert the string into a binary address and stores this address in a buffer whose address is addr. 
		err=bt_addr_le_from_str("DE:AD:BE:AF:BA:11","random" , &addr);  //Only random static address can be given when the type is set to "random"
                if (err) {
			printk("Invalid BT address (err %d)\n", err);
						}

                //create a new Identity address. This must be done before enabling Bluetooth. Addr is the address used for the new identity
		err1=bt_id_create(&addr, NULL);
                if (err1 < 0) {
			printk("Creating new ID failed (err %d)\n", err1);
		}
            printk("Created new address\n");
 }

void main(void)
{
	int err;

	printk("Starting Observer Demo\n");

	set_random_static_address();

	/* Initialize the Bluetooth Subsystem */
	err = bt_enable(NULL);
	if (err) {
		printk("Bluetooth init failed (err %d)\n", err);
		return;
	}

	(void)observer_start();

	// printk("Exiting %s thread.\n", __func__);
}
```

## src/observer.c
```c
#include <stddef.h>

#include "headers/main_observer.h"
#include <zephyr/bluetooth/bluetooth.h>
#include <zephyr/bluetooth/hci.h>
#include <zephyr/logging/log.h>
#include <zephyr/kernel.h>
#include <zephyr/sys/printk.h>

#include <zephyr/drivers/gpio.h>
#include <zephyr/pm/pm.h>
#include <zephyr/device.h>
#include <hal/nrf_gpio.h>
#include <zephyr/devicetree.h>
#include <stdio.h>
#include <string.h>
#include <math.h>

#define DELAY_TIME K_MSEC(1000)

uint8_t remote1 = 15;

int ret;
/* The devicetree node identifier for the "led0" alias. */

#define LED1_NODE DT_ALIAS(led1)
static const struct gpio_dt_spec led1 = GPIO_DT_SPEC_GET(LED1_NODE, gpios);

#define LED0_NODE DT_ALIAS(led0)
static const struct gpio_dt_spec led0 = GPIO_DT_SPEC_GET(LED0_NODE, gpios);

#define LED2_NODE DT_ALIAS(led2)
static const struct gpio_dt_spec led2 = GPIO_DT_SPEC_GET(LED2_NODE, gpios);

#define STACKSIZE	 2048
#define THREAD0_PRIORITY 7

static int connection_flag = 0;
static int counter_remote1 = 0;
// static int counter_remote2 = 0;
LOG_MODULE_DECLARE(gateway, LOG_LEVEL_DBG);

/* Index write_index to write data in flash */
// extern int write_index = 0;
#define n  3
#define n1 3

/* It is data callback function. It is executed whenever the system recieves an advertising packet.
 */
#if defined(CONFIG_BT_EXT_ADV)
static bool data_cb(struct bt_data *data, void *user_data)
{

	int total_write = pow(
		2, n); // total number of bytes to be written corresponding to one received packet
	int chunk_size = pow(
		2, n1); // total number of bytes to be written in one write operation [max.= 128]
	// int num_steps = pow(2, (n - n1)); // number of iterations in which the entire packet gets
	// written into the memory
	uint8_t write_array[chunk_size];
	write_array[0] = 0;

	/* data_cb is executed whenever some advertising packet comes. */
	LOG_INF("IN DATA CB");

	// len is the length of the advertising packet.
	// uint8_t len;

	switch (data->type) {
	case BT_DATA_NAME_SHORTENED:
	case BT_DATA_NAME_COMPLETE:
	case BT_DATA_MANUFACTURER_DATA:

		int index = 0;

		/* It is just a variable that runs from 0 to 128. */
		int j = 0;

		// Storing chunk_size BYTES OF DATA AT ONCE //
		for (j = 0; j < chunk_size; j++) {
			/* Using char (char = 1 byte uint8_t type). */
			char number = data->data[j + index];
			/* Appending them in write array. */
			write_array[j] = number;
			printk("%d ", write_array[j]);
		}
	}

	if (write_array[0] == remote1) {
		counter_remote1++;
		if (counter_remote1 == 1) {
			gpio_pin_configure_dt(&led1, GPIO_OUTPUT | GPIO_ACTIVE_LOW);
			gpio_pin_set_dt(&led1, 1);
			// gpio_pin_toggle_dt(&led1);

		} else if (counter_remote1 == 2) {
			gpio_pin_configure_dt(&led1, GPIO_OUTPUT | GPIO_ACTIVE_LOW);

			gpio_pin_set_dt(&led1, 0);
			counter_remote1 = 0;
			
		}
	}
}

static const char *phy2str(uint8_t phy)
{
	switch (phy) {
	case BT_GAP_LE_PHY_NONE:
		return "No packets";
	case BT_GAP_LE_PHY_1M:
		return "LE 1M";
	case BT_GAP_LE_PHY_2M:
		return "LE 2M";
	case BT_GAP_LE_PHY_CODED:
		return "LE Coded";
	default:
		return "Unknown";
	}
}
static void scan_recv(const struct bt_le_scan_recv_info *info, struct net_buf_simple *buf)
{
	/* Executed when we recieve the packet from advertising node. */
	char le_addr[BT_ADDR_LE_STR_LEN];
	uint8_t data_status;
	uint16_t data_len;
	char name[30];
	//  (void)memset(name, 0, sizeof(name));

	data_len = buf->len;
	bt_data_parse(buf, data_cb, name);

	data_status = BT_HCI_LE_ADV_EVT_TYPE_DATA_STATUS(info->adv_props);

	bt_addr_le_to_str(info->addr, le_addr, sizeof(le_addr));
}

static struct bt_le_scan_cb scan_callbacks = {
	.recv = scan_recv,
};
#endif /* CONFIG_BT_EXT_ADV */

int observer_start(void)
{

	bt_addr_le_t addr1;

	bt_addr_le_from_str("DE:AD:BE:AF:BA:11", "random", &addr1);

	int err = bt_le_filter_accept_list_add(&addr1);
	if (err == 0) {
		printk("Successfully added the address to Filter Accept List..\n");
	} else {
		printk("Failed to update Filter Accept List..\n");
	}

	struct bt_le_scan_param scan_param = {
		.type = BT_LE_SCAN_TYPE_PASSIVE,
		.options = BT_LE_SCAN_OPT_FILTER_DUPLICATE | BT_LE_SCAN_OPT_FILTER_ACCEPT_LIST,
		.interval = 0x0030,
		.window = 0x0030,
	};

	bt_le_scan_cb_register(&scan_callbacks);
	err = bt_le_scan_start(&scan_param, NULL);

	if (err) {
		LOG_INF("Start scanning failed (err %d)\n", err);
		return err;
	}
	LOG_INF("Started scanning...\n");
	return 0;
}

int init_observer(void)
{
	/* Observer Initialization. */
	LOG_ERR("observer init.....");

	/* Enabling Bluetooth. */
	int err = bt_enable(NULL);
	if (err) {
		LOG_ERR("Bluetooth init failed (err %d)\n", err);
		return err;
	}

	return 0;
}
```
