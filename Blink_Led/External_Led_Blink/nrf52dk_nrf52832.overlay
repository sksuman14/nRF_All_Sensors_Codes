/* For External LED Configuration */

/ {
    leds {
        compatible = "gpio-leds";
        led0: led_0 {
            gpios = <&gpio0 25 GPIO_ACTIVE_LOW>;
            label = "Green LED 0";
        };
    };
};
